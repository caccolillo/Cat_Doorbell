/include/ "system-conf.dtsi"
/ {
    amba_pl: amba_pl@0 {
  	krnl_img_averaging@0xa00a0000 {
    		clock-names = "s_axi_aclk";
    		clocks = <&zynqmp_clk 71>;
    		compatible = "xlnx,krnl-img-averaging-1.0";
    		reg = <0x0 0xa00a0000 0x0 0x10000>;
    		xlnx,s-axi-control-addr-width = <0x7>;
    		xlnx,s-axi-control-data-width = <0x20>;
  	};
    };
};
